## boards/arm/gpiote_test/Kconfig.board
```kconfig
# Copyright (c) 2023 Nordic Semiconductor ASA
# SPDX-License-Identifier: Apache-2.0

config BOARD_GPIOTE_TEST
	bool "gpiote_test"
	depends on SOC_NRF52840_QIAA
```

## boards/arm/gpiote_test/Kconfig.defconfig
```kconfig
# Copyright (c) 2023 Nordic Semiconductor ASA
# SPDX-License-Identifier: Apache-2.0

if BOARD_GPIOTE_TEST

config BOARD
	default "gpiote_test"

config BT_CTLR
   default BT

endif
```
